AUTOSAR XML (schema 00050)
package /ModeDeclarationGroups
  mode declaration group ProcessStateMachine: initial-mode=Idle
    5 x mode:
      Idle: value=1
      Starting: value=2
      Running: value=3
      Terminating: value=4
      Terminated: value=5
package /control_Executable
  executable control: build-type=BUILD-TYPE-DEBUG, logging-behavior=USES-LOGGING
    root sw component prototype control_RootSwComponentPrototype: application-type=control
package /control_FunctionGroupSet
  function group set DefaultFunctionGroupSet
    function-groups:
      mode declaration group prototype DefaultFunctionGroupSet_ModeDeclarationGroupElement: sw-calibration-access=READ-ONLY, type=MachineFG
package /control_ProcessDesigns
  process design DefaultProcessDesign: executable=control
package /control_ProcessToMachineMappingSet
  process to machine mapping set ProcessToMachineMappingSet
    process to machine mapping DefaultMapping: machine=Host, process=DefaultInstance
package /control_Processes
  process DefaultInstance: design=DefaultProcessDesign, executable=control, state-dependent-startup-config{function-group-state=DefaultFunctionGroupSet_ModeDeclarationGroupElement.Running, resource-group=DefaultResourceGroup, startup-config=StartupConfigRR}
    process state machine ProcessStateMachine_ModeDeclarationGroupElement: sw-calibration-access=READ-ONLY, type=ProcessStateMachine
package /control_StartupConfigs
  startup config StartupConfigRR: process-arguments=[-s, ServiceInstanceManifest.json, -e, ExecutionManifest.json], scheduling-policy=SCHEDULING-POLICY-ROUND-ROBIN, scheduling-priority=32
  startup config StartupConfigFifo: process-arguments=[-s, ServiceInstanceManifest.json, -e, ExecutionManifest.json], scheduling-policy=SCHEDULING-POLICY-FIFO, scheduling-priority=32
  startup config StartupConfigOther: process-arguments=[-s, ServiceInstanceManifest.json, -e, ExecutionManifest.json], scheduling-policy=SCHEDULING-POLICY-OTHER, scheduling-priority=32
