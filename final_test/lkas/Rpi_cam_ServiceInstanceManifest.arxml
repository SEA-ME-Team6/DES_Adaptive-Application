AUTOSAR XML (schema 00050)
package /Rpi_cam_CommunicationCluster
  ethernet cluster ComCluster
    ethernet physical channel PhysicalChannel
      network endpoint NetworkEndpoint: network-endpoint-addresses=ipv-4-configuration=ipv-4-address=127.0.0.1
package /Rpi_cam_Deployments
  dds service interface deployment DdsDeployment_ProvidedPort: transport-protocols=TCP
    dds event deployment Deployment_Out1: event=Out1, topic-name=Out1, transport-protocols=TCP
  someip service interface deployment SomeipDeployment_ProvidedPort
    someip event group EventGroup_ProvidedPort: event-group-id=59050
package /Rpi_cam_MachineDesign
  machine design MachineDesign
    ethernet communication connector CommunicationConnector: unicast-network-endpoint=NetworkEndpoint
package /Rpi_cam_ServiceInstToMachineMap
  dds service instance to machine mapping DdsServiceInstToMachineMap_DdsSI_ProvidedPort: communication-connector=CommunicationConnector, service-instance=DdsSI_ProvidedPort
  someip service instance to machine mapping SomeIpServiceInstToMachineMap_SomeipSI_ProvidedPort: communication-connector=CommunicationConnector, service-instance=SomeipSI_ProvidedPort
  someip service instance to machine mapping SomeIpServiceInstToMachineMap_SomeipSI_ProvidedPort_SomeipSI_ProvidedPort: communication-connector=CommunicationConnector, service-instance=SomeipSI_ProvidedPort
package /Rpi_cam_ServiceInstanceToPortMappings
  service instance to port prototype mapping Mapping_ProvidedPort: port-prototype=Rpi_cam.ProvidedPort, process-design=DefaultProcessDesign, service-instance=SomeipSI_ProvidedPort
package /Rpi_cam_ServiceInstances
  dds provided service instance DdsSI_ProvidedPort: service-interface-deployment=DdsDeployment_ProvidedPort, domain-id=0, dds-event-qos-props{qos-profile=RELIABLE, event=Deployment_Out1}, service-instance-id=1
  provided someip service instance SomeipSI_ProvidedPort: service-interface-deployment=SomeipDeployment_ProvidedPort, service-instance-id=1
