AUTOSAR XML (schema 00050)
package /Components
  adaptive application sw component type ultrasonic
    provide port ProvidedPort: provided-interface=ProvidedInterface
