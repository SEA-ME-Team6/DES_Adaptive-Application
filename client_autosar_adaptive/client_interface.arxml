AUTOSAR XML (schema 00051)
package /Interfaces
  service interface ProvidedInterface
    events:
      data Out1: sw-calibration-access=READ-ONLY
  service interface RequiredInterface
    events:
      data In1: category=VALUE, sw-calibration-access=READ-ONLY, sw-impl-policy=QUEUED, type=double
