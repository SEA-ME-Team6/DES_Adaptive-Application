AUTOSAR XML (schema 00051)
package /Components
  adaptive application sw component type client
    require port RequiredPort: queued-receiver-com-spec=data-element=In1, required-interface=RequiredInterface
    provide port ProvidedPort: provided-interface=ProvidedInterface
