AUTOSAR XML (schema 00051)
package /ultrasonic_CommunicationCluster
  ethernet cluster ComCluster
    ethernet physical channel PhysicalChannel
      network endpoint NetworkEndpoint: network-endpoint-addresses=ipv-4-configuration=ipv-4-address=127.0.0.1
package /ultrasonic_Deployments
  dds service interface deployment DdsDeployment_ProvidedPort: transport-protocols=TCP
    dds event deployment Deployment_Brake: event=Brake, topic-name=Brake, transport-protocols=TCP
  someip service interface deployment SomeipDeployment_ProvidedPort
    someip event deployment Deployment_Brake: event=Brake, event-id=8645
    someip event group EventGroup_ProvidedPort: event-group-id=8645, event=Deployment_Brake
package /ultrasonic_MachineDesign
  machine design MachineDesign
    ethernet communication connector CommunicationConnector: unicast-network-endpoint=NetworkEndpoint
package /ultrasonic_ServiceInstToMachineMap
  dds service instance to machine mapping DdsServiceInstToMachineMap_DdsSI_ProvidedPort: communication-connector=CommunicationConnector, service-instance=DdsSI_ProvidedPort
  dds service instance to machine mapping DdsServiceInstToMachineMap_DdsSI_ProvidedPort_DdsSI_ProvidedPort: communication-connector=CommunicationConnector, service-instance=DdsSI_ProvidedPort
  someip service instance to machine mapping SomeIpServiceInstToMachineMap_SomeipSI_ProvidedPort: communication-connector=CommunicationConnector, service-instance=SomeipSI_ProvidedPort
  someip service instance to machine mapping SomeIpServiceInstToMachineMap_SomeipSI_ProvidedPort_SomeipSI_ProvidedPort: communication-connector=CommunicationConnector, service-instance=SomeipSI_ProvidedPort
package /ultrasonic_ServiceInstanceToPortMappings
  service instance to port prototype mapping Mapping_ProvidedPort: port-prototype=ultrasonic.ProvidedPort, process-design=DefaultProcessDesign, service-instance=SomeipSI_ProvidedPort
package /ultrasonic_ServiceInstances
  dds provided service instance DdsSI_ProvidedPort: service-interface-deployment=DdsDeployment_ProvidedPort, domain-id=0, dds-event-qos-props{qos-profile=RELIABLE, event=Deployment_Brake}, service-instance-id=1
  provided someip service instance SomeipSI_ProvidedPort: service-interface-deployment=SomeipDeployment_ProvidedPort, service-instance-id=1
    someip provided event group ProvidedEventGroup_ProvidedPort: event-group=EventGroup_ProvidedPort
