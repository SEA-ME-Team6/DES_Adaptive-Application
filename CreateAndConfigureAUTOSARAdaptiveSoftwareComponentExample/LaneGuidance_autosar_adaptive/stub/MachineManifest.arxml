AUTOSAR XML (schema 00050)
package /LaneGuidance_DltApplicationToProcessMapping
  dlt application to process mapping DltApplicationToProcessMapping: dlt-application=DefaultDltApplication, process=DefaultInstance
package /LaneGuidance_DltEcu
  dlt ecu DefaultDltEcu
    dlt application DefaultDltApplication: application-description=Log messages for adaptive application LaneGuidance, application-id=3163
package /LaneGuidance_DltLogSink
  dlt log sink DefaultDltLogSink: category=DLT_LOGSINK_CONSOLE, default-log-threshold=WARN
package /MachineStates
  mode declaration group MachineFG: initial-mode=Running
    7 x mode:
      Off: value=1
      Startup: value=2
      Running: value=3
      Idle: value=4
      Shutdown: value=5
      Restart: value=6
      Verify: value=7
package /Machines
  machine Host: default-application-timeout={enter-timeout-value=60, exit-timeout-value=60}, machine-design=MachineDesign
    module-instantiations:
      os module instantiation HostOsInstantiation
        resource group DefaultResourceGroup: cpu-usage=100, mem-usage=4096000000
      log and trace instantiation LaneGuidance_LogAndTraceInstantiation: dlt-ecu=DefaultDltEcu, log-sink=DefaultDltLogSink
