AUTOSAR XML (schema 00050)
package /LaneGuidance_Executable
  executable LaneGuidance: build-type=BUILD-TYPE-DEBUG, logging-behavior=USES-LOGGING
    root sw component prototype LaneGuidance_RootSwComponentPrototype: application-type=LaneGuidance
package /LaneGuidance_FunctionGroupSet
  function group set DefaultFunctionGroupSet
    function-groups:
      mode declaration group prototype DefaultFunctionGroupSet_ModeDeclarationGroupElement: sw-calibration-access=READ-ONLY, type=MachineFG
package /LaneGuidance_ProcessDesigns
  process design DefaultProcessDesign: executable=LaneGuidance
package /LaneGuidance_ProcessToMachineMappingSet
  process to machine mapping set ProcessToMachineMappingSet
    process to machine mapping DefaultMapping: machine=Host, process=DefaultInstance
package /LaneGuidance_Processes
  process DefaultInstance: design=DefaultProcessDesign, executable=LaneGuidance, state-dependent-startup-config{function-group-state=DefaultFunctionGroupSet_ModeDeclarationGroupElement.Running, resource-group=DefaultResourceGroup, startup-config=StartupConfigRR}
    process state machine ProcessStateMachine_ModeDeclarationGroupElement: sw-calibration-access=READ-ONLY, type=ProcessStateMachine
package /LaneGuidance_StartupConfigs
  startup config StartupConfigRR: scheduling-policy=SCHEDULING-POLICY-ROUND-ROBIN, scheduling-priority=32
  startup config StartupConfigFifo: scheduling-policy=SCHEDULING-POLICY-FIFO, scheduling-priority=32
  startup config StartupConfigOther: scheduling-policy=SCHEDULING-POLICY-OTHER, scheduling-priority=32
package /ModeDeclarationGroups
  mode declaration group ProcessStateMachine: initial-mode=Idle
    5 x mode:
      Idle: value=1
      Starting: value=2
      Running: value=3
      Terminating: value=4
      Terminated: value=5
