AUTOSAR XML (schema 00050)
package /Interfaces
  service interface ProvidedInterface
    events:
      data LeftHazardIndicator: category=VALUE, sw-calibration-access=READ-ONLY, sw-impl-policy=QUEUED, type=double
      data RightHazardIndicator: category=VALUE, sw-calibration-access=READ-ONLY, sw-impl-policy=QUEUED, type=double
  service interface RequiredInterface
    events:
      6 x data, all with category=VALUE, sw-calibration-access=READ-ONLY, sw-impl-policy=QUEUED, type=double:
        LeftLaneDistance
        LeftTurnIndicator
        RightLaneDistance
        RightTurnIndicator
        LeftCarInBlindSpot
        RightCarInBlindSpot
