AUTOSAR XML (schema 00050)
package /LaneGuidance_CommunicationCluster
  ethernet cluster ComCluster
    ethernet physical channel PhysicalChannel
      network endpoint NetworkEndpoint: network-endpoint-addresses=ipv-4-configuration=ipv-4-address=127.0.0.1
package /LaneGuidance_Deployments
  dds service interface deployment DdsDeployment_RequiredPort: transport-protocols=TCP
    6 x dds event deployment, all with transport-protocols=TCP:
      Deployment_LeftLaneDistance: event=LeftLaneDistance, topic-name=LeftLaneDistance
      Deployment_LeftTurnIndicator: event=LeftTurnIndicator, topic-name=LeftTurnIndicator
      Deployment_RightLaneDistance: event=RightLaneDistance, topic-name=RightLaneDistance
      Deployment_RightTurnIndicator: event=RightTurnIndicator, topic-name=RightTurnIndicator
      Deployment_LeftCarInBlindSpot: event=LeftCarInBlindSpot, topic-name=LeftCarInBlindSpot
      Deployment_RightCarInBlindSpot: event=RightCarInBlindSpot, topic-name=RightCarInBlindSpot
  dds service interface deployment DdsDeployment_ProvidedPort: transport-protocols=TCP
    dds event deployment Deployment_LeftHazardIndicator: event=LeftHazardIndicator, topic-name=LeftHazardIndicator, transport-protocols=TCP
    dds event deployment Deployment_RightHazardIndicator: event=RightHazardIndicator, topic-name=RightHazardIndicator, transport-protocols=TCP
package /LaneGuidance_MachineDesign
  machine design MachineDesign
    ethernet communication connector CommunicationConnector: unicast-network-endpoint=NetworkEndpoint
package /LaneGuidance_ServiceInstToMachineMap
  dds service instance to machine mapping DdsServiceInstToMachineMap_DdsSI_RequiredPort: communication-connector=CommunicationConnector, service-instance=DdsSI_RequiredPort
  dds service instance to machine mapping DdsServiceInstToMachineMap_DdsSI_ProvidedPort: communication-connector=CommunicationConnector, service-instance=DdsSI_ProvidedPort
package /LaneGuidance_ServiceInstanceToPortMappings
  service instance to port prototype mapping Mapping_RequiredPort: port-prototype=LaneGuidance.RequiredPort, process-design=DefaultProcessDesign, service-instance=DdsSI_RequiredPort
  service instance to port prototype mapping Mapping_ProvidedPort: port-prototype=LaneGuidance.ProvidedPort, process-design=DefaultProcessDesign, service-instance=DdsSI_ProvidedPort
package /LaneGuidance_ServiceInstances
  dds required service instance DdsSI_RequiredPort: service-interface-deployment=DdsDeployment_RequiredPort, domain-id=0, required-service-instance-id=1
    event-qos-propss:
      qos-profile=RELIABLE, event=Deployment_LeftLaneDistance
      qos-profile=RELIABLE, event=Deployment_LeftTurnIndicator
      qos-profile=RELIABLE, event=Deployment_RightLaneDistance
      qos-profile=RELIABLE, event=Deployment_RightTurnIndicator
      qos-profile=RELIABLE, event=Deployment_LeftCarInBlindSpot
      qos-profile=RELIABLE, event=Deployment_RightCarInBlindSpot
  dds provided service instance DdsSI_ProvidedPort: service-interface-deployment=DdsDeployment_ProvidedPort, domain-id=0, service-instance-id=2
    event-qos-propss:
      qos-profile=RELIABLE, event=Deployment_LeftHazardIndicator
      qos-profile=RELIABLE, event=Deployment_RightHazardIndicator
