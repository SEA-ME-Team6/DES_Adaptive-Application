AUTOSAR XML (schema 00051)
package /Interfaces
  service interface ProvidedInterface
    events:
      data Error: category=VALUE, sw-calibration-access=READ-ONLY, sw-impl-policy=QUEUED, type=double
