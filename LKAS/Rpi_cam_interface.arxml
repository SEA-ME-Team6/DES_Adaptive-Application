AUTOSAR XML (schema 00050)
package /Interfaces
  service interface ProvidedInterface
    events:
      data Out1: category=VALUE, sw-calibration-access=READ-ONLY, sw-impl-policy=QUEUED, type=double
      data Error: category=VALUE, sw-calibration-access=READ-ONLY, sw-impl-policy=QUEUED, type=double
