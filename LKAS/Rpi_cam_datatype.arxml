AUTOSAR XML (schema 00050)
package /AUTOSAR/StdTypes
  std cpp implementation data type double: category=VALUE
