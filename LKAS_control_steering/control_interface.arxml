AUTOSAR XML (schema 00050)
package /Interfaces
  service interface ProvidedInterface
    events:
      data Throttle: category=VALUE, sw-calibration-access=READ-ONLY, sw-impl-policy=QUEUED, type=double
      data Steering: category=VALUE, sw-calibration-access=READ-ONLY, sw-impl-policy=QUEUED, type=double
  service interface RequiredInterface
    events:
      data AEB: category=VALUE, sw-calibration-access=READ-ONLY, sw-impl-policy=QUEUED, type=double
      data LKAS: category=VALUE, sw-calibration-access=READ-ONLY, sw-impl-policy=QUEUED, type=double
