AUTOSAR XML (schema 00050)
package /Components
  adaptive application sw component type control
    require port RequiredPort: queued-receiver-com-spec=data-element=LKAS, required-interface=RequiredInterface
    provide port ProvidedPort: queued-sender-com-spec=data-element=Steering, provided-interface=ProvidedInterface
