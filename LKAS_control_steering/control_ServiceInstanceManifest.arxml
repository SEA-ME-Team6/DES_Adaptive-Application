AUTOSAR XML (schema 00050)
package /control_CommunicationCluster
  ethernet cluster ComCluster
    ethernet physical channel PhysicalChannel
      network endpoint NetworkEndpoint: network-endpoint-addresses=ipv-4-configuration=ipv-4-address=127.0.0.1
package /control_Deployments
  dds service interface deployment DdsDeployment_RequiredPort: transport-protocols=TCP
    dds event deployment Deployment_LKAS: event=LKAS, topic-name=LKAS, transport-protocols=TCP
  dds service interface deployment DdsDeployment_ProvidedPort: transport-protocols=TCP
    dds event deployment Deployment_Steering: event=Steering, topic-name=Steering, transport-protocols=TCP
  someip service interface deployment SomeipDeployment_RequiredPort
    someip event deployment Deployment_LKAS: event=LKAS, event-id=14859
    someip event group EventGroup_RequiredPort: event-group-id=14859, event=Deployment_LKAS
  someip service interface deployment SomeipDeployment_ProvidedPort
    someip event deployment Deployment_Steering: event=Steering, event-id=12225
    someip event group EventGroup_ProvidedPort: event-group-id=12225, event=Deployment_Steering
package /control_MachineDesign
  machine design MachineDesign
    ethernet communication connector CommunicationConnector: unicast-network-endpoint=NetworkEndpoint
package /control_ServiceInstToMachineMap
  dds service instance to machine mapping DdsServiceInstToMachineMap_DdsSI_RequiredPort: communication-connector=CommunicationConnector, service-instance=DdsSI_RequiredPort
  dds service instance to machine mapping DdsServiceInstToMachineMap_DdsSI_ProvidedPort: communication-connector=CommunicationConnector, service-instance=DdsSI_ProvidedPort
  someip service instance to machine mapping SomeIpServiceInstToMachineMap_SomeipSI_RequiredPort: communication-connector=CommunicationConnector, service-instance=SomeipSI_RequiredPort
  someip service instance to machine mapping SomeIpServiceInstToMachineMap_SomeipSI_ProvidedPort: communication-connector=CommunicationConnector, service-instance=SomeipSI_ProvidedPort
package /control_ServiceInstanceToPortMappings
  service instance to port prototype mapping Mapping_RequiredPort: port-prototype=control.RequiredPort, process-design=DefaultProcessDesign, service-instance=SomeipSI_RequiredPort
  service instance to port prototype mapping Mapping_ProvidedPort: port-prototype=control.ProvidedPort, process-design=DefaultProcessDesign, service-instance=SomeipSI_ProvidedPort
package /control_ServiceInstances
  dds required service instance DdsSI_RequiredPort: service-interface-deployment=DdsDeployment_RequiredPort, domain-id=0, dds-event-qos-props{qos-profile=RELIABLE, event=Deployment_LKAS}, required-service-instance-id=1
  dds provided service instance DdsSI_ProvidedPort: service-interface-deployment=DdsDeployment_ProvidedPort, domain-id=0, dds-event-qos-props{qos-profile=RELIABLE, event=Deployment_Steering}, service-instance-id=2
  required someip service instance SomeipSI_RequiredPort: service-interface-deployment=SomeipDeployment_RequiredPort, required-service-instance-id=1
    someip required event group RequiredEventGroup_RequiredPort: event-group=EventGroup_RequiredPort
  provided someip service instance SomeipSI_ProvidedPort: service-interface-deployment=SomeipDeployment_ProvidedPort, service-instance-id=2
    someip provided event group ProvidedEventGroup_ProvidedPort: event-group=EventGroup_ProvidedPort
