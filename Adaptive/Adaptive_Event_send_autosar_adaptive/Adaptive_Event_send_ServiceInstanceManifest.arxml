AUTOSAR XML (schema 00050)
package /Rpi_cam_CommunicationCluster
  ethernet cluster ComCluster
    ethernet physical channel PhysicalChannel
      network endpoint NetworkEndpoint: network-endpoint-addresses=ipv-4-configuration=ipv-4-address=127.0.0.1
package /Rpi_cam_Deployments
  dds service interface deployment DdsDeployment_ProvidedPort: transport-protocols=TCP
    dds event deployment Deployment_Error: event=Error, topic-name=Error, transport-protocols=TCP
package /Rpi_cam_MachineDesign
  machine design MachineDesign
    ethernet communication connector CommunicationConnector: unicast-network-endpoint=NetworkEndpoint
package /Rpi_cam_ServiceInstToMachineMap
  dds service instance to machine mapping DdsServiceInstToMachineMap_DdsSI_ProvidedPort: communication-connector=CommunicationConnector, service-instance=DdsSI_ProvidedPort
  dds service instance to machine mapping DdsServiceInstToMachineMap_DdsSI_ProvidedPort_DdsSI_Error: communication-connector=CommunicationConnector
package /Rpi_cam_ServiceInstanceToPortMappings
  service instance to port prototype mapping Mapping_ProvidedPort: port-prototype=Rpi_cam.ProvidedPort, process-design=DefaultProcessDesign, service-instance=DdsSI_ProvidedPort
package /Rpi_cam_ServiceInstances
  dds provided service instance DdsSI_ProvidedPort: service-interface-deployment=DdsDeployment_ProvidedPort, domain-id=0, dds-event-qos-props{qos-profile=RELIABLE, event=Deployment_Error}, service-instance-id=1
