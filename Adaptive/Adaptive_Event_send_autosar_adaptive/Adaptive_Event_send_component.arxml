AUTOSAR XML (schema 00050)
package /Components
  adaptive application sw component type Rpi_cam
    provide port ProvidedPort: queued-sender-com-spec=data-element=Error, provided-interface=ProvidedInterface
