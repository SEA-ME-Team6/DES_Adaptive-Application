AUTOSAR XML (schema 00051)
package /lkas_CommunicationCluster
  ethernet cluster ComCluster
    ethernet physical channel PhysicalChannel
      network endpoint NetworkEndpoint: network-endpoint-addresses=ipv-4-configuration=ipv-4-address=127.0.0.1
package /lkas_Deployments
  dds service interface deployment DdsDeployment_ProvidedPort: transport-protocols=TCP
    dds event deployment Deployment_Error: event=Error, topic-name=Error, transport-protocols=TCP
  someip service interface deployment SomeipDeployment_ProvidedPort
    someip event deployment Deployment_Error: event=Error, event-id=59050
    someip event group EventGroup_ProvidedPort: event-group-id=59050, event=Deployment_Error
package /lkas_MachineDesign
  machine design MachineDesign
    ethernet communication connector CommunicationConnector: unicast-network-endpoint=NetworkEndpoint
package /lkas_ServiceInstToMachineMap
  dds service instance to machine mapping DdsServiceInstToMachineMap_DdsSI_ProvidedPort: communication-connector=CommunicationConnector, service-instance=DdsSI_ProvidedPort
  someip service instance to machine mapping SomeIpServiceInstToMachineMap_SomeipSI_ProvidedPort: communication-connector=CommunicationConnector, service-instance=SomeipSI_ProvidedPort
  someip service instance to machine mapping SomeIpServiceInstToMachineMap_SomeipSI_ProvidedPort_SomeipSI_ProvidedPort: communication-connector=CommunicationConnector, service-instance=SomeipSI_ProvidedPort
package /lkas_ServiceInstanceToPortMappings
  service instance to port prototype mapping Mapping_ProvidedPort: port-prototype=lkas.ProvidedPort, process-design=DefaultProcessDesign, service-instance=SomeipSI_ProvidedPort
package /lkas_ServiceInstances
  dds provided service instance DdsSI_ProvidedPort: service-interface-deployment=DdsDeployment_ProvidedPort, domain-id=0, dds-event-qos-props{qos-profile=RELIABLE, event=Deployment_Error}, service-instance-id=1
  provided someip service instance SomeipSI_ProvidedPort: service-interface-deployment=SomeipDeployment_ProvidedPort, service-instance-id=1
    someip provided event group ProvidedEventGroup_ProvidedPort: event-group=EventGroup_ProvidedPort
