AUTOSAR XML (schema 00051)
package /Components
  adaptive application sw component type control
    require port RequiredPort: queued-receiver-com-spec=data-element=LKAS, required-interface=RequiredInterface
    provide port ProvidedPort: provided-interface=ProvidedInterface
