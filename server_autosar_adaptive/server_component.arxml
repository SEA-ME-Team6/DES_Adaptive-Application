AUTOSAR XML (schema 00051)
package /Components
  adaptive application sw component type server
    provide port ProvidedPort: queued-sender-com-spec=data-element=Out1, provided-interface=ProvidedInterface
