AUTOSAR XML (schema 00049)
package /Interfaces
  service interface ProvidedInterface
    events:
      data Out1: category=VALUE, sw-calibration-access=READ-ONLY, sw-impl-policy=QUEUED, type=double
  service interface RequiredInterface
    events:
      data In1: category=VALUE, sw-calibration-access=READ-ONLY, sw-impl-policy=QUEUED, type=double
