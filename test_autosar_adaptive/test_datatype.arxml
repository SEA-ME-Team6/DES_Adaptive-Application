AUTOSAR XML (schema 00049)
package /AUTOSAR/StdTypes
  std cpp implementation data type double: category=VALUE
