AUTOSAR XML (schema 00049)
package /test_CommunicationCluster
  ethernet cluster ComCluster
    ethernet physical channel PhysicalChannel
      network endpoint NetworkEndpoint: network-endpoint-addresses=ipv-4-configuration=ipv-4-address=127.0.0.1
package /test_Deployments
  dds service interface deployment DdsDeployment_RequiredPort: transport-protocols=TCP
    dds event deployment Deployment_In1: event=In1, topic-name=In1, transport-protocols=TCP
  dds service interface deployment DdsDeployment_ProvidedPort: transport-protocols=TCP
    dds event deployment Deployment_Out1: event=Out1, topic-name=Out1, transport-protocols=TCP
package /test_MachineDesign
  machine design MachineDesign
    ethernet communication connector CommunicationConnector: unicast-network-endpoint=NetworkEndpoint
package /test_ServiceInstToMachineMap
  dds service instance to machine mapping DdsServiceInstToMachineMap_DdsSI_RequiredPort: communication-connector=CommunicationConnector, service-instance=DdsSI_RequiredPort
  dds service instance to machine mapping DdsServiceInstToMachineMap_DdsSI_ProvidedPort: communication-connector=CommunicationConnector, service-instance=DdsSI_ProvidedPort
package /test_ServiceInstanceToPortMappings
  service instance to port prototype mapping Mapping_RequiredPort: port-prototype=test.RequiredPort, process-design=DefaultProcessDesign, service-instance=DdsSI_RequiredPort
  service instance to port prototype mapping Mapping_ProvidedPort: port-prototype=test.ProvidedPort, process-design=DefaultProcessDesign, service-instance=DdsSI_ProvidedPort
package /test_ServiceInstances
  dds required service instance DdsSI_RequiredPort: service-interface-deployment=DdsDeployment_RequiredPort, domain-id=0, dds-event-qos-props{qos-profile=RELIABLE, event=Deployment_In1}, required-service-instance-id=1
  dds provided service instance DdsSI_ProvidedPort: service-interface-deployment=DdsDeployment_ProvidedPort, domain-id=0, dds-event-qos-props{qos-profile=RELIABLE, event=Deployment_Out1}, service-instance-id=2
