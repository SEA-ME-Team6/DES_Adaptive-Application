AUTOSAR XML (schema 00050)
package /untitled_Executable
  executable untitled: build-type=BUILD-TYPE-DEBUG, logging-behavior=USES-LOGGING
    root sw component prototype untitled_RootSwComponentPrototype: application-type=SoATest
package /untitled_FunctionGroupSet
  function group set DefaultFunctionGroupSet
    function-groups:
      mode declaration group prototype DefaultFunctionGroupSet_ModeDeclarationGroupElement: sw-calibration-access=READ-ONLY, type=MachineFG
package /untitled_ProcessDesigns
  process design DefaultProcessDesign: executable=untitled
package /untitled_ProcessToMachineMappingSet
  process to machine mapping set ProcessToMachineMappingSet
    process to machine mapping DefaultMapping: machine=Host, process=DefaultInstance
package /untitled_Processes
  process DefaultInstance: design=DefaultProcessDesign, executable=untitled, state-dependent-startup-config{function-group-state=DefaultFunctionGroupSet_ModeDeclarationGroupElement.Running, resource-group=DefaultResourceGroup, startup-config=StartupConfigRR}
    process state machine ProcessStateMachine_ModeDeclarationGroupElement: sw-calibration-access=READ-ONLY, type=ProcessStateMachine
package /untitled_StartupConfigs
  startup config StartupConfigRR: scheduling-policy=SCHEDULING-POLICY-ROUND-ROBIN, scheduling-priority=32
  startup config StartupConfigFifo: scheduling-policy=SCHEDULING-POLICY-FIFO, scheduling-priority=32
  startup config StartupConfigOther: scheduling-policy=SCHEDULING-POLICY-OTHER, scheduling-priority=32
