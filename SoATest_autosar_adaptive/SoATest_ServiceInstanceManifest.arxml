AUTOSAR XML (schema 00049)
package /SoATest_CommunicationCluster
  ethernet cluster ComCluster
    ethernet physical channel PhysicalChannel
      network endpoint NetworkEndpoint: network-endpoint-addresses=ipv-4-configuration=ipv-4-address=127.0.0.1
package /SoATest_Deployments
  dds service interface deployment DdsDeployment_ProvidedPort: transport-protocols=TCP
    dds event deployment Deployment_Out1: event=Out1, topic-name=Out1, transport-protocols=TCP
package /SoATest_MachineDesign
  machine design MachineDesign
    ethernet communication connector CommunicationConnector: unicast-network-endpoint=NetworkEndpoint
package /SoATest_ServiceInstToMachineMap
  dds service instance to machine mapping DdsServiceInstToMachineMap_DdsSI_ProvidedPort: communication-connector=CommunicationConnector, service-instance=DdsSI_ProvidedPort
package /SoATest_ServiceInstanceToPortMappings
  service instance to port prototype mapping Mapping_ProvidedPort: port-prototype=SoATest.ProvidedPort, process-design=DefaultProcessDesign, service-instance=DdsSI_ProvidedPort
package /SoATest_ServiceInstances
  dds provided service instance DdsSI_ProvidedPort: service-interface-deployment=DdsDeployment_ProvidedPort, domain-id=0, dds-event-qos-props{qos-profile=RELIABLE, event=Deployment_Out1}, service-instance-id=1
