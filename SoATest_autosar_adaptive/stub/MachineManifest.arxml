AUTOSAR XML (schema 00049)
package /MachineStates
  mode declaration group MachineFG: initial-mode=Running
    7 x mode:
      Off: value=1
      Startup: value=2
      Running: value=3
      Idle: value=4
      Shutdown: value=5
      Restart: value=6
      Verify: value=7
package /Machines
  machine Host: default-application-timeout={enter-timeout-value=60, exit-timeout-value=60}, machine-design=MachineDesign
    module-instantiations:
      os module instantiation HostOsInstantiation
        resource group DefaultResourceGroup: cpu-usage=100, mem-usage=4096000000
      log and trace instantiation SoATest_LogAndTraceInstantiation
        dlt log channel DefaultDltLogChannel: application-description=Log messages for adaptive application SoATest, application-id=8020, log-trace-default-log-level=WARN, log-trace-log-modes=CONSOLE
package /SoATest_DltLogChannelToProcessMapping
  dlt log channel to process mapping DltLogChannelToProcessMapping: dlt-log-channel=DefaultDltLogChannel, process=DefaultInstance
