AUTOSAR XML (schema 00049)
package /Components
  adaptive application sw component type SoATest
    provide port ProvidedPort: queued-sender-com-spec=data-element=Out1, provided-interface=ProvidedInterface
